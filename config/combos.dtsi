/*                                      46 KEY MATRIX / LAYOUT MAPPING

  ╭────────────────────────╮               ╭────────────────────────╮
  │  0   1   2   3   4   5 │               │  6   7   8   9  10  11 │
  │ 12  13  14  15  16  17 ╰──╮         ╭──╯ 18  19  20  21  22  23 │
  │ 24  25  26  27  28  29  36╰────┬────╯37  30  31  32  33  34  35 │
  ╰───────────────╮ 38  39  40  41 │ 42  43  44  45 ╭───────────────╯
                  ╰────────────────┴────────────────╯
                  
 ╭─────────────────────────╮               ╭─────────────────────────╮
 │ LT5 LT4 LT3 LT2 LT1 LT0 │               │ RT0 RT1 RT2 RT3 RT4 RT5 │
 │ LM5 LM4 LM3 LM2 LM1 LM0 ╰──╮         ╭──╯ RM0 RM1 RM2 RM3 RM4 RM5 │
 │ LB5 LB4 LB3 LB2 LB1 LB0 LH4╰────┬────╯RH4 RB0 RB1 RB2 RB3 RB4 RB5 │
 ╰───────────────╮ LH3 LH2 LH1 LH0 │ RH0 RH1 RH2 RH3 ╭───────────────╯
                 ╰─────────────────┴───── ───────────╯
 T : Top
 M : Middle
 B : Bottom
 H : Hand
 P : Palm
*/



#define COMBO_TERM_FAST 18
#define COMBO_TERM_SLOW 30

#define COMBO_IDLE_FAST 150
#define COMBO_IDLE_SLOW 50


/* Horizontal combos - left hand */


/* Horizontal combos - right hand */


/* Vertical combos - left hand */
ZMK_COMBO(num1,    &kp N1,        LT4 LM4,     DEF NAV, COMBO_TERM_SLOW, COMBO_IDLE_SLOW)
ZMK_COMBO(num2,    &kp N2,        LT3 LM3,     DEF NAV, COMBO_TERM_SLOW, COMBO_IDLE_SLOW)
ZMK_COMBO(num3,    &kp N3,        LT2 LM2,     DEF NAV, COMBO_TERM_SLOW, COMBO_IDLE_SLOW)
ZMK_COMBO(num4,    &kp N4,        LT1 LM1,     DEF NAV, COMBO_TERM_SLOW, COMBO_IDLE_SLOW)
ZMK_COMBO(num5,    &kp N5,        LM0 LB0,     DEF NAV, COMBO_TERM_SLOW, COMBO_IDLE_SLOW)


/* Vertical combos - right hand */
ZMK_COMBO(num6,    &kp N6,        RT0 RM0,     DEF NAV, COMBO_TERM_SLOW, COMBO_IDLE_SLOW)
ZMK_COMBO(num7,    &kp N7,        RT1 RM1,     DEF NAV, COMBO_TERM_SLOW, COMBO_IDLE_SLOW)
ZMK_COMBO(num8,    &kp N8,        RT2 RM2,     DEF NAV, COMBO_TERM_SLOW, COMBO_IDLE_SLOW)
ZMK_COMBO(num9,    &kp N9,        RT3 RM3,     DEF NAV, COMBO_TERM_SLOW, COMBO_IDLE_SLOW)
ZMK_COMBO(num0,    &kp N0,        RM4 RB4,     DEF NAV, COMBO_TERM_SLOW, COMBO_IDLE_SLOW)



/*
/ {

/* Vertical combos - left hand */
    combos {
        compatible = "zmk,combos";
        num1 {
            timeout-ms = <50>;
            key-positions = <1 13>;
            bindings = <&kp N1>;
        };

        num2 {
            timeout-ms = <50>;
            key-positions = <2 14>;
            bindings = <&kp N2>;
        };

        num3 {
            timeout-ms = <50>;
            key-positions = <3 15>;
            bindings = <&kp N3>;
        };

        num4 {
            timeout-ms = <50>;
            key-positions = <4 16>;
            bindings = <&kp N4>;
        };

        num5 {
            timeout-ms = <50>;
            key-positions = <5 17>;
            bindings = <&kp N5>;
        };

/* Vertical combos - right hand */

        num6 {
            timeout-ms = <50>;
            key-positions = <6 18>;
            bindings = <&kp N6>;
        };

        num7 {
            timeout-ms = <50>;
            key-positions = <7 19>;
            bindings = <&kp N7>;
        };

        num8 {
            timeout-ms = <50>;
            key-positions = <8 20>;
            bindings = <&kp N8>;
        };

        num9 {
            timeout-ms = <50>;
            key-positions = <9 21>;
            bindings = <&kp N9>;
        };

        num0 {
            timeout-ms = <50>;
            key-positions = <10 22>;
            bindings = <&kp N0>;
        };
    };
};
*/
